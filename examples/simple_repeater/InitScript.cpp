// InitScript.cpp — see InitScript.h for the design overview.

#include "InitScript.h"

#include "MyMesh.h"     // handleCommand: serial-privilege dispatch (as execCliLine)
#include "CliUtil.h"    // CLI_REPLY_BUFFER_MAX
#include "init_cmds_data.h"  // generated by scripts/gen_init_cmds.py (build-time)

#include <string.h>

#define INIT_SCRIPT_MARKER  "/init_cmds.done"

// The marker stores the NAME of the last completed section (v5 design:
// version-name resume, no hash, no journal). 63 chars + NUL.
#define INIT_MARKER_MAX     64
#define INIT_IMPLICIT_NAME  "all"   // recorded when the list has no #! sections

// The CLI itself refuses commands longer than ~180 chars ("Err - command too
// long"), so a 196-byte line buffer cannot silently truncate a command that
// would have been accepted: an over-long line is refused whole, matching CLI
// behavior.
static char line[196];
static char reply[CLI_REPLY_BUFFER_MAX];
static bool attempted = false;

// Apply one NUL-terminated line. Returns false when the CLI rejected it
// (reply starts with the convention-wide "Err" prefix) — stop-on-first-error.
static bool applyLine(MyMesh& mesh, size_t n) {
  line[n] = 0;
  if (n > 0 && line[n - 1] == '\r') line[--n] = 0;   // companions may send CRLF
  if (n == 0 || line[0] == '#') return true;         // blank / comment
  reply[0] = 0;
  mesh.handleCommand(0, line, reply);  // serial-privilege dispatch, like execCliLine
  return strncmp(reply, "Err", 3) != 0;
}

static void recordSection(FILESYSTEM* fs, const char* name) {
  File out = fs->open(INIT_SCRIPT_MARKER, FILE_WRITE);
  if (out) { out.print(name); out.close(); }
}

void runInitScript(MyMesh& mesh, FILESYSTEM* fs) {
  if (attempted) return;                 // once per boot, whatever the outcome
  attempted = true;

  const size_t total = INIT_CMDS_LEN;
  if (total == 0) return;                // no init list baked in: normal boot

  // Resume protocol: the list is split into sections by `#! <name>` headers
  // closed by `#! end`. /init_cmds.done stores the name of the last COMPLETED
  // section. On boot: a fresh node (no marker) runs everything; otherwise the
  // firmware skips forward through the section named by the marker and runs
  // only what comes after it. A marker naming a section that no longer exists
  // means the list was rewritten wholesale: run nothing (the operator who
  // rewrote the list must add a new section to apply anything).
  char marker[INIT_MARKER_MAX] = { 0 };
  {
    File m = fs->open(INIT_SCRIPT_MARKER, FILE_READ);
    if (m) {
      size_t k = 0;
      int c;
      while (k < sizeof(marker) - 1 && (c = m.read()) > 0) {
        if (c == '\n' || c == '\r') break;
        marker[k++] = (char)c;
      }
      marker[k] = 0;
      m.close();
    }
  }
  const bool fresh = (marker[0] == 0);

  bool exec = fresh;          // apply body lines right now?
  bool saw_section = false;   // any '#! <name>' header seen in the list
  bool in_target = false;     // inside the section named by the marker
  bool passed_target = false; // marker's section closed → run everything after
  bool in_section = false;    // currently between '#! <name>' and '#! end'
  char cur[INIT_MARKER_MAX] = { 0 };  // current section name
  bool ok = true;

  // Stream the flash-resident list one line at a time.
  size_t n = 0;
  for (size_t i = 0; i <= total && ok; i++) {
    char c = (char)pgm_read_byte(&INIT_CMDS_DATA[i]);
    if (i == total) c = '\n';            // synthesize the final line end
    if (c != '\n') {
      if (n < sizeof(line) - 1) line[n++] = c;
      else ok = false;                   // over-long: refused whole, like the CLI
      continue;
    }
    line[n] = 0;
    if (n > 0 && line[n - 1] == '\r') line[n - 1] = 0;

    if (line[0] == '#' && line[1] == '!') {
      const char* arg = line + 2;
      while (*arg == ' ' || *arg == '\t') arg++;
      if (strcmp(arg, "end") == 0 || arg[0] == 0) {
        // section boundary: an executing section is complete → record it
        if (in_target) {
          in_target = false;
          passed_target = true;          // resume point passed
          exec = true;
        } else if (exec && cur[0]) {
          recordSection(fs, cur);        // completed section = new resume point
        }
        cur[0] = 0;
        in_section = false;
      } else {
        // '#! <name>': start a section. While seeking the marker's section,
        // everything stays unexecuted; after it, everything executes.
        snprintf(cur, sizeof(cur), "%s", arg);
        saw_section = true;
        in_section = true;
        in_target = (!fresh && !passed_target && strcmp(cur, marker) == 0);
        exec = fresh || passed_target;
      }
    } else if (line[0] == '#') {
      // plain comment: never dispatched
    } else if (n > 0 && exec && (in_section || (!saw_section && fresh))) {
      // Body lines execute: inside the active section, or in the prologue of a
      // fresh node (lines before the first '#!' header — they own the whole
      // list only when the list has no sections at all). Trailing lines after
      // the final '#! end' are ignored, so nothing can re-run every boot.
      if (!applyLine(mesh, n)) {
        // Hard "once": a section that errored is recorded as applied anyway so
        // a half-configured node never boot-loops; fix the list and reflash.
        recordSection(fs, cur[0] ? cur : INIT_IMPLICIT_NAME);
        ok = false;
      }
    }
    n = 0;
  }

  // A list with no sections at all is one implicit section: after a complete
  // fresh run, record the sentinel so it never re-runs.
  if (!saw_section && fresh && ok) recordSection(fs, INIT_IMPLICIT_NAME);

  if (!ok) {
    Serial.printf("init[cmds] section had errors; recorded as applied — edit init_cmds.txt, "
                  "add a new #! section and reflash to apply changes\n");
  }
}